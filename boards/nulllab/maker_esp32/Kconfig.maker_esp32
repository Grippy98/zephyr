## boards/nulllab/maker_esp32/Kconfig.maker_esp32
```kconfig
# Copyright (c) 2026 Grippy98
# SPDX-License-Identifier: Apache-2.0

config BOARD_MAKER_ESP32
	select SOC_ESP32_WROOM_32UE_N4
	select SOC_ESP32_PROCPU if BOARD_MAKER_ESP32_ESP32_PROCPU
	select SOC_ESP32_APPCPU if BOARD_MAKER_ESP32_ESP32_APPCPU
```

## boards/nulllab/maker_esp32/board.yml
```yaml
board:
  name: maker_esp32
  full_name: Maker ESP32
  vendor: nulllab
  socs:
  - name: esp32
```

## boards/nulllab/maker_esp32/maker_esp32_appcpu_defconfig
```kconfig
# Copyright (c) 2026 Grippy98
# SPDX-License-Identifier: Apache-2.0

CONFIG_CLOCK_CONTROL=y
```

## drivers/pwm/Kconfig.ehrpwm
```kconfig
# Copyright (c) 2024 Your Name
# SPDX-License-Identifier: Apache-2.0

config PWM_EHRPWM
	bool "TI eHRPWM driver"
	default y
	depends on DT_HAS_TI_EHRPWM_ENABLED
	help
	  Enable driver for TI eHRPWM.
```
